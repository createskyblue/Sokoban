#include <Arduboy2.h>
Arduboy2 arduboy;
#include <EEPROM.h>
/*=========================================================
                         位图
  =========================================================*/
//启动画面
const uint8_t BOOT[] PROGMEM = {
  0x00, 0x00, 0x00, 0x00, 0x00, 0x00, 0x00, 0x00, 0x00, 0x00, 0x00, 0x08,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 0xba
};
//墙的贴图
const uint8_t WALL[] PROGMEM = {
  0xff, 0xff, 0x00, 0x80, 0x01, 0x80, 0x80, 0x01, 0x40, 0x80, 0x01, 0x20,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 0xfc
};
//箱子的贴图
const uint8_t BOX[] PROGMEM = {
  0x00, 0x00, 0x00, 0x00, 0x00, 0x00, 0x3f, 0xfe, 0x00, 0x20, 0x83, 0x00,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 0x00
};
//打开的箱子贴图
const uint8_t OBOX[] PROGMEM = {
  0x00, 0x00, 0x00, 0x00, 0x00, 0x00, 0x00, 0x00, 0x00, 0x1f, 0xfc, 0x00,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 0x00
};
//小人朝上的贴图
const uint8_t ManUp[] PROGMEM = {
  0x00, 0x00, 0x00, 0x00, 0x00, 0x00, 0x00, 0x00, 0x00, 0x00, 0x00, 0x00,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 0x00
};
//小人朝下的贴图
const uint8_t ManDown[] PROGMEM = {
  0x00, 0x00, 0x00, 0x00, 0x00, 0x00, 0x00, 0x00, 0x00, 0x00, 0x00, 0x00,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 0x00
};
//小人朝左的贴图
const uint8_t ManLeft[] PROGMEM = {
  0x00, 0x00, 0x00, 0x00, 0x00, 0x00, 0x00, 0x00, 0x00, 0x00, 0x00, 0x00,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 0x00
};
//小人朝右的贴图
const uint8_t ManRight[] PROGMEM = {
  0x00, 0x00, 0x00, 0x00, 0x00, 0x00, 0x00, 0x00, 0x00, 0x00, 0x00, 0x00,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 0x00
};
/*=========================================================
                         地图
  =========================================================*/
const PROGMEM byte MAP[42][16][16] = {
  //LEVEL 1
  0, 0, 0, 0, 0, 0, 0, 0, 0, 0, 0, 0,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 0,
  //LEVEL 2
  1 , 1 , 1 , 1 , 1 , 0, 0, 0, 0, 0, 0, 0,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 0,
  //LEVEL 3
  0, 1 , 1 , 1 , 1 , 1 , 1 , 1 , 0, 0, 0, 0,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 0,
  //LEVEL 4
  0, 1 , 1 , 1 , 1 , 0, 0, 0, 0, 0, 0, 0,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 0,
  //LEVEL 5
  0, 1 , 1 , 1 , 1 , 1 , 0, 0, 0, 0, 0, 0,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 0,
  //LEVEL 6
  0, 0, 0, 1 , 1 , 1 , 1 , 1 , 1 , 1 , 0, 0,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 0,
  //LEVEL 7
  0, 0, 0, 0, 0, 0, 0, 0, 0, 0, 0, 0,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 0,
  //LEVEL 8
  0, 0, 0, 1 , 1 , 1 , 1 , 1 , 1 , 0, 0, 0,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 0,
  //LEVEL 9
  0, 1 , 1 , 1 , 1 , 1 , 1 , 1 , 1 , 1 , 0, 0,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 0,
  //LEVEL 10
  0, 0, 1 , 1 , 1 , 1 , 1 , 1 , 0, 0, 0, 0,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 0,
  //LEVEL 11
  0, 1 , 1 , 1 , 1 , 0, 0, 1 , 1 , 1 , 1 , 1 ,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 0,
  //LEVEL 12
  0, 0, 1 , 1 , 1 , 1 , 1 , 0, 0, 0, 0, 0,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 0,
  //LEVEL 13
  0, 0, 1 , 1 , 1 , 1 , 0, 0, 0, 0, 0, 0,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 0,
  //LEVEL 14
  1 , 1 , 1 , 1 , 1 , 1 , 1 , 1 , 0, 0, 0, 0,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 0,
  //LEVEL 15
  0, 1 , 1 , 1 , 1 , 1 , 1 , 0, 0, 0, 0, 0,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 0,
  //LEVEL 16
  0, 0, 1 , 1 , 1 , 1 , 1 , 1 , 1 , 1 , 0, 0,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 0,
  //LEVEL 17
  1 , 1 , 1 , 1 , 1 , 1 , 0, 0, 0, 0, 0, 0,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 0,
  //LEVEL 18
  0, 0, 1 , 1 , 1 , 1 , 1 , 1 , 1 , 1 , 0, 0,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 0,
  //LEVEL 19
  0, 1 , 1 , 1 , 1 , 1 , 1 , 1 , 0, 0, 0, 0,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 0,
  //LEVEL 20
  1 , 1 , 1 , 1 , 1 , 1 , 1 , 0, 0, 0, 0, 0,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 0,
  //LEVEL 21
  0, 0, 0, 1 , 1 , 1 , 1 , 1 , 1 , 0, 0, 0,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 0,
  //LEVEL 22
  1 , 1 , 1 , 1 , 1 , 1 , 1 , 1 , 0, 0, 0, 0,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 0,
  //LEVEL 23
  0, 0, 1 , 1 , 1 , 1 , 1 , 0, 0, 0, 0, 0,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 0,
  //LEVEL 24
  1 , 1 , 1 , 1 , 1 , 1 , 0, 0, 0, 1 , 1 , 1 ,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 0,
  //LEVEL 25
  0, 1 , 1 , 1 , 1 , 1 , 1 , 1 , 1 , 1 , 0, 0,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 0,
  //LEVEL 26
  1 , 0, 0, 0, 0, 1 , 0, 1 , 0, 1 , 0, 0,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 1 ,
  //LEVEL 27
  0, 0, 0, 0, 0, 0, 0, 0, 0, 0, 0, 0,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 0,
  //LEVEL 28
  0, 0, 0, 0, 1 , 1 , 1 , 1 , 0, 0, 0, 0,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 0,
  //LEVEL 29
  1 , 1 , 1 , 1 , 1 , 1 , 1 , 1 , 0, 0, 0, 0,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 0,
  //LEVEL 30
  0, 0, 1 , 1 , 1 , 1 , 1 , 1 , 1 , 1 , 1 , 1 ,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 0,
  //LEVEL 31
  0, 0, 0, 1 , 1 , 1 , 1 , 1 , 1 , 0, 0, 0,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 0,
  //LEVEL 32
  0, 1 , 1 , 1 , 1 , 1 , 1 , 0, 0, 0, 0, 0,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 0,
  //LEVEL 33
  0, 0, 0, 0, 0, 0, 0, 0, 0, 0, 0, 0,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 0,
  //LEVEL 34
  1 , 1 , 1 , 1 , 1 , 1 , 1 , 1 , 1 , 1 , 1 , 1 ,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 0,
  //LEVEL 35
  1 , 1 , 1 , 1 , 1 , 1 , 1 , 1 , 1 , 0, 0, 0,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 0,
  //LEVEL 36
  1 , 1 , 1 , 1 , 1 , 1 , 1 , 1 , 0, 0, 0, 0,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 0,
  //LEVEL 37
  0, 0, 0, 0, 1 , 1 , 1 , 1 , 1 , 0, 0, 0,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 0,
  //LEVEL 38
  0, 0, 1 , 1 , 1 , 1 , 1 , 1 , 1 , 1 , 1 , 1 ,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 0,
  //LEVEL 39
  1 , 1 , 1 , 1 , 1 , 1 , 1 , 1 , 1 , 0, 0, 0,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 0,
  //LEVEL 40
  1, 1, 1, 1, 1, 1, 1, 1, 1, 1, 1, 1, 1, 1, 1, 1,
  1, 1, 1, 4, 1, 0, 4, 0, 1, 1, 0, 0, 1, 4, 4, 1,
  1, 1, 0, 0, 0, 0, 0, 0, 4, 0, 0, 3, 1, 0, 0, 1,
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  1, 1, 1, 1, 1, 1, 1, 1, 1, 1, 1, 1, 1, 1, 1, 1,
  //LEVEL 41
  0, 0, 0, 0, 0, 0, 0, 0, 0, 0, 0, 0,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 0,
  //LEVEL 42
  0, 0, 0, 0, 0, 0, 0, 0, 0, 0, 0, 0,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 0,
  //0->空白
  //1->墙
  //2->人
  //3->箱子
  //4->位置
  //5->放到正确位置的箱子
  //6->在标签上的人
  //每个地图大小16*16 可以自行添加
};
/*=========================================================
                         变量
  =========================================================*/
bool DisplayInvert = true;
int Pstep; //玩家步数
byte CP = 1; //关卡
byte ACP = 42;  //关卡总数
int RMAP[16][16]; //运行地图
byte DX, DY, CDX, CDY;
byte PMX, PMY; //玩家在地图中的位置 0:x 1:y
int CPDX, CPDY; //玩家朝向x和y轴
byte PlayerD = 1; //最后方向 默认1 也就是下
boolean LA = false; //行动是否合法
boolean WIN = false; //检测是否通关
byte SBDPL[] = {1, 2};  //障碍物id
/*====================================================================
                             软重启函数
  ====================================================================*/
void(* resetFunc) (void) = 0; //制造重启命令
/*=========================================================
                     只循环一次
  =========================================================*/
void setup() {
  arduboy.boot();
  arduboy.invert(DisplayInvert);
  arduboy.drawSlowXYBitmap(0, 0, BOOT, 128, 64, 1);
  arduboy.setCursor(2, 2);
  arduboy.print(F("Sokoban\nBY LHW"));
  arduboy.display();
  byte ERC = 0; //EEProm Check
  //检查EEPROM
  for (int i = 0; i < 7; i++) {
    ERC = EEPROM.read(i) + ERC;
    //EEPROM 0   1   2   3   4   5   6
    //      115 111 107 111 98  97  110
    //       s   o   k   o   b   a   n
  }
  if (ERC != 237) {
    arduboy.clear();
    arduboy.println(F("initialize the EEPROM"));
    arduboy.print(ERC);
    arduboy.print("!=");
    arduboy.println(byte(115 + 111 + 107 + 111 + 98 + 97 + 110));
    arduboy.display();
    //初始化EEPROM
    for (int i = 0 ; i < EEPROM.length() ; i++) {
      EEPROM.write(i, 0);
    }
    EEPROM.write(0, 115);
    EEPROM.write(1, 111);
    EEPROM.write(2, 107);
    EEPROM.write(3, 111);
    EEPROM.write(4, 98);
    EEPROM.write(5, 97);
    EEPROM.write(6, 110);
    ERC = 0;
    for (int i = 0; i < 7; i++) {
      ERC = EEPROM.read(i) + ERC;
    }
    if (ERC != 0) resetFunc(); else arduboy.println(F("EEPROM writing error"));
    arduboy.display();
  }
  delay(1500);
  //加载地图
  load_cp();   //把地图载入内存
  draw(); //渲染画面
}
void loop() {
  LA = false;                           //是否刷新移动  否
  if (arduboy.pressed(B_BUTTON)) {
    load_cp();                          //把当前关卡地图载入内存
    draw();                             //渲染画面
  }
  if (arduboy.pressed(A_BUTTON)) {      //打开菜单
    GMenu();
  }
  //键盘控制玩家部分
  if (arduboy.pressed(UP_BUTTON)) {
    PlayerD = 0;//设置玩家方向
    CPDX = 0;
    CPDY = -1;
    SBDP();
  } else if (arduboy.pressed(DOWN_BUTTON)) {
    PlayerD = 1;//设置玩家方向
    CPDX = 0;
    CPDY = 1;
    SBDP();
  } else if (arduboy.pressed(LEFT_BUTTON)) {
    PlayerD = 2;//设置玩家方向
    CPDX = -1;
    CPDY = 0;
    SBDP();
  } else if (arduboy.pressed(RIGHT_BUTTON)) {
    PlayerD = 3;//设置玩家方向
    CPDX = 1;
    CPDY = 0;
    SBDP();
  }
  if (LA == true) {
    //行动合法
    //如果脚下是空的
    if (RMAP[PMX + CPDX * 0][PMY + CPDY * 0] == 2) {
      if (RMAP[PMX + CPDX * 1][PMY + CPDY * 1] == 0) {
        //如果前方是空气
        RMAP[PMX + CPDX * 1][PMY + CPDY * 1] = 2;
        RMAP[PMX + CPDX * 0][PMY + CPDY * 0] = 0;
        Pstep++; //增加玩家步数
      } else if (RMAP[PMX + CPDX * 1][PMY + CPDY * 1] == 4) {  //如果前方是标记
        RMAP[PMX + CPDX * 1][PMY + CPDY * 1] = 6;
        RMAP[PMX + CPDX * 0][PMY + CPDY * 0] = 0;
        Pstep++; //增加玩家步数
      } else if (RMAP[PMX + CPDX * 1][PMY + CPDY * 1] == 5) {  //如果前面不是标记而是标记上有箱子
        //如果前方标签上的箱子前面是空气
        if (RMAP[PMX + CPDX * 2][PMY + CPDY * 2] == 0) {
          RMAP[PMX + CPDX * 2][PMY + CPDY * 2] = 3;
          RMAP[PMX + CPDX * 1][PMY + CPDY * 1] = 6;
          RMAP[PMX + CPDX * 0][PMY + CPDY * 0] = 0;
          Pstep++; //增加玩家步数
        } else if (RMAP[PMX + CPDX * 2][PMY + CPDY * 2] == 4) {  //如果前方标签上的箱子前面是标签
          RMAP[PMX + CPDX * 2][PMY + CPDY * 2] = 5;
          RMAP[PMX + CPDX * 1][PMY + CPDY * 1] = 6;
          RMAP[PMX + CPDX * 0][PMY + CPDY * 0] = 0;
          Pstep++; //增加玩家步数
        }
      } else if (RMAP[PMX + CPDX * 1][PMY + CPDY * 1] == 3) {  //前方是箱子
        //箱子前面是空气
        if (RMAP[PMX + CPDX * 2][PMY + CPDY * 2] == 0) {
          RMAP[PMX + CPDX * 2][PMY + CPDY * 2] = 3;
          RMAP[PMX + CPDX * 1][PMY + CPDY * 1] = 2;
          RMAP[PMX + CPDX * 0][PMY + CPDY * 0] = 0;
          Pstep++; //增加玩家步数
        } else if (RMAP[PMX + CPDX * 2][PMY + CPDY * 2] == 4) {
          //箱子前面是标记
          RMAP[PMX + CPDX * 2][PMY + CPDY * 2] = 5;
          RMAP[PMX + CPDX * 1][PMY + CPDY * 1] = 2;
          RMAP[PMX + CPDX * 0][PMY + CPDY * 0] = 0;
          Pstep++; //增加玩家步数
        }
      }
    } else if (RMAP[PMX + CPDX * 0][PMY + CPDY * 0] == 6) { //如果前面不是空气并且脚下有标记
      if (RMAP[PMX + CPDX * 1][PMY + CPDY * 1] == 0) {
        RMAP[PMX + CPDX * 1][PMY + CPDY * 1] = 2; //如果前方是空气
        RMAP[PMX + CPDX * 0][PMY + CPDY * 0] = 4;
        Pstep++; //增加玩家步数
      } else  if (RMAP[PMX + CPDX * 1][PMY + CPDY * 1] == 4) { //如果前方依然是是标记
        RMAP[PMX + CPDX * 1][PMY + CPDY * 1] = 6;
        RMAP[PMX + CPDX * 0][PMY + CPDY * 0] = 4;
        Pstep++; //增加玩家步数
      } else if (RMAP[PMX + CPDX * 1][PMY + CPDY * 1] == 5) {
        if (RMAP[PMX + CPDX * 2][PMY + CPDY * 2] == 0) { //如果前方标签上的箱子前面是空气
          RMAP[PMX + CPDX * 2][PMY + CPDY * 2] = 3;
          RMAP[PMX + CPDX * 1][PMY + CPDY * 1] = 6;
          RMAP[PMX + CPDX * 0][PMY + CPDY * 0] = 4;
          Pstep++; //增加玩家步数
        } else if (RMAP[PMX + CPDX * 2][PMY + CPDY * 2] == 4) {//如果前方标签上的箱子前面是标签
          RMAP[PMX + CPDX * 2][PMY + CPDY * 2] = 5;
          RMAP[PMX + CPDX * 1][PMY + CPDY * 1] = 6;
          RMAP[PMX + CPDX * 0][PMY + CPDY * 0] = 4;
          Pstep++; //增加玩家步数
        }
        Pstep++; //增加玩家步数
      } else if (RMAP[PMX + CPDX * 1][PMY + CPDY * 1] == 3) {//如果前方只有箱子，箱子前面但是脚下有标签
        if (RMAP[PMX + CPDX * 2][PMY + CPDY * 2] == 0) {  //箱子前面是空气
          RMAP[PMX + CPDX * 2][PMY + CPDY * 2] = 3;
          RMAP[PMX + CPDX * 1][PMY + CPDY * 1] = 2;
          RMAP[PMX + CPDX * 0][PMY + CPDY * 0] = 4;
          Pstep++; //增加玩家步数
        } else  if (RMAP[PMX + CPDX * 2][PMY + CPDY * 2] == 4) {//箱子前面是标签
          RMAP[PMX + CPDX * 2][PMY + CPDY * 2] = 5;
          RMAP[PMX + CPDX * 1][PMY + CPDY * 1] = 2;
          RMAP[PMX + CPDX * 0][PMY + CPDY * 0] = 4;
          Pstep++; //增加玩家步数
        }
      }
    }
    draw();//渲染画面
    delay(50); //防止游戏过快
  }
  if (WIN == true) win(); //检测到通关 调用通关函数
}
void SBDP() {
  LA = true;
  byte length = sizeof(SBDPL) / sizeof(SBDPL[0]);
  for (byte i = 0; i < length; i++) {
    if (RMAP[PMX + CPDX * 1][PMY + CPDY * 1] == SBDPL[i]) LA = false;
  }
}
void draw() {
  arduboy.clear();                                        //清除显存
  DrawMap();                                              //渲染游戏地图
  arduboy.display();                                      //把画面显示到OLED上
}
void load_cp() {
  Pstep = 0; //清空玩家步数
  for (byte MapReadY = 0; MapReadY < 16; MapReadY++) {
    for (byte MapReadX = 0; MapReadX < 16; MapReadX++) {
      RMAP[MapReadX][MapReadY] = pgm_read_byte(&MAP[CP - 1][MapReadY][MapReadX]);
    }
  }
}
void DrawMap() {
  WIN = true;//假设玩家通关
  for (byte MapReadY = 0; MapReadY < 16; MapReadY++) {
    for (byte MapReadX = 0; MapReadX < 16; MapReadX++) {
      switch (RMAP[MapReadX][MapReadY]) {
        case 2:
          PMX = MapReadX;   //当前是玩家所在的位置 重设玩家所在地图位置
          PMY = MapReadY;
          break;
        case 3:
          WIN = false;   //检测到没有放在指定位置的箱子 表明玩家没有通关
          break;
        case 6:
          PMX = MapReadX;   //当前是玩家所在的位置 重设玩家所在地图位置
          PMY = MapReadY;
          break;
      }
    }
  }
  int MapReadLimit[4]; //显示地图缓存读取范围 防止溢出死循环
  MapReadLimit[0] = PMX - 4;
  MapReadLimit[1] = PMX + 5;
  MapReadLimit[2] = PMY - 2;
  MapReadLimit[3] = PMY + 3;
  if (MapReadLimit[0] < 0) CDX = 15 * (-MapReadLimit[0]); else CDX = 0;
  if (MapReadLimit[2] < 0) CDY = 15 * (-MapReadLimit[2]); else CDY = 0;
  DX = CDX;
  DY = CDY;
  for (byte i = 0; i < 4; i++) {
    if (MapReadLimit[i] < 0) MapReadLimit[i] = 0; else if (MapReadLimit[i] > 15) MapReadLimit[i] = 15;
  }
  for (byte MapReadY = MapReadLimit[2]; MapReadY <= MapReadLimit[3]; MapReadY++) {
    for (byte MapReadX = MapReadLimit[0]; MapReadX <= MapReadLimit[1]; MapReadX++) {
      //0->空白
      //1->墙
      //2->人
      //3->箱子
      //4->位置
      //5->放到正确位置的箱子
      //6->在标签上的人
      switch (RMAP[MapReadX][MapReadY]) {
        case 1:
          //画墙
          arduboy.fillRect(DX - 6,  DY - 6, 16, 16, 0);                                 //清空重绘区
          arduboy.drawLine(DX, DY + 10, DX, DY + 14, BLACK);                            //处理渲染错误的线条
          arduboy.drawLine(DX + 10, DY, DX + 14, DY, BLACK);                            //处理渲染错误的线条
          arduboy.drawSlowXYBitmap(DX - 6, DY - 6,  WALL, 22, 22, 1);                   //显示墙的图片
          break;
        case 2:
          DrawPlayer();                                                                 //显示玩家
          break;
        case 3:
          DrawBox();                                                                    //显示箱子
          break;
        case 4:
          DrawTag();                                                                    //在对应的位置画一个"X"
          break;
        case 5:
          arduboy.drawSlowXYBitmap(DX - 6, DY - 6, OBOX, 22, 22, 1);                    //显示打开的箱子图片
          break;
        case 6:
          DrawTag();
          DrawPlayer();
          break;
      }
      DX += 15;
    }
    DX = CDX;
    DY += 15;
  }
}
void DrawPlayer() {
  //画玩家
  arduboy.fillRect(DX - 1,  DY - 2, 16, 17, 0);                                   //清空重绘区
  if (PlayerD == 0) {                                                           //如果玩家方向为上
    arduboy.drawSlowXYBitmap(DX - 6, DY - 6,  ManUp, 22, 22, 1);                  //玩家向上图片
  } else {
    if (PlayerD == 1) {//如果玩家方向为下
      arduboy.drawSlowXYBitmap(DX - 6, DY - 6, ManDown, 22, 22, 1);               //玩家向下图片
    } else {
      if (PlayerD == 2) {//如果玩家方向为左
        arduboy.drawSlowXYBitmap(DX - 6, DY - 6, ManLeft, 22, 22, 1);             //玩家向左图片
      } else {                                                                    //如果玩家方向不是上 也不是下 更不是左 （右）
        arduboy.drawSlowXYBitmap(DX - 6, DY - 6,  ManRight, 22, 22, 1);           //玩家向右图片
      }
    }
  }
}
void DrawBox() {
  //画箱子
  arduboy.drawSlowXYBitmap(DX - 6, DY - 6, OBOX, 22, 22, 0);  //消除过多像素
  arduboy.drawSlowXYBitmap(DX - 6, DY - 6,  BOX, 22, 22, 1);
}
void DrawTag() {
  //画标记
  arduboy.drawLine(DX + 5, DY + 5, DX + 16, DY + 16, WHITE);
  arduboy.drawLine(DX + 16, DY + 5, DX + 5, DY + 16, WHITE);
}

void win() {
  boolean NE = false;
  //读取EEPROM
  if (EEPROM.read(6 + CP) > Pstep || EEPROM.read(6 + CP) == 0) {
    //破纪录
    EEPROM.write(6 + CP, Pstep);
    NE = true;
  }
  arduboy.clear();                          //清空显存
  arduboy.drawRect(4, 4, 120, 56, 1);
  arduboy.drawLine(44, 4, 76, 4, 0);
  arduboy.setCursor(52, 2);               //设置光标
  arduboy.print(F("WIN"));                 //打印 你赢了
  arduboy.setCursor(32, 16);
  arduboy.print(F("Step "));
  arduboy.print(Pstep);
  arduboy.setCursor(32, 24);
  arduboy.print(F("History "));
  arduboy.print(EEPROM.read(6 + CP));
  if (NE) {
    arduboy.setCursor(32, 40);
    arduboy.print(F("NEW RECORD"));
  }
  arduboy.display();                        //把画面显示在OLED上
  while (!arduboy.pressed(A_BUTTON)) {}
  if (CP < ACP) {                           //如果当前关卡少于总关卡
    CP++;                                   //那么关卡数+1
  } else {                                  //否则如果是最后一关
    CP = 1;                                 //切换回去第一关
  }
  load_cp();                               //把地图载入内存
  arduboy.clear();
  DrawMap();
  arduboy.display();
  delay(50);
}
void GMenu() {
  while ((arduboy.pressed(A_BUTTON))) {
    arduboy.clear();                                        //清除显存
    DrawMap();                                              //渲染游戏地图
    arduboy.fillRect(88,  0, 40, 128, 1);                   //清空重绘区
    arduboy.setTextColor(0);
    arduboy.setTextBackground(1);
    arduboy.setCursor(96, 8);                               //设置光标
    arduboy.print(F("Level"));                                      //显示当前关卡
    arduboy.setCursor(96, 16);                               //设置光标
    arduboy.print(CP);
    arduboy.print(F("~"));                                     //显示分隔符
    arduboy.print(ACP);                                     //显示一共有多少关
    arduboy.setCursor(96, 40);
    arduboy.print(F("Step"));
    arduboy.setCursor(96, 48);
    arduboy.print(Pstep);
    arduboy.setTextColor(1);
    arduboy.setTextBackground(0);
    if (arduboy.pressed(UP_BUTTON)) {   //上键与A键同时按下
      if (CP < ACP) CP++;               //如果不是最后一关 让关卡数+1
      load_cp();                               //把地图载入内存
    }
    if (arduboy.pressed(DOWN_BUTTON)) { //下键与A键同时按下
      if (CP > 1) CP--;                 //如果不是第一关 让关卡数-1
      load_cp();                               //把地图载入内存
    }
    if (arduboy.pressed(LEFT_BUTTON)) {
      DisplayInvert = ! DisplayInvert;
      arduboy.invert(DisplayInvert);
      delay(50);
    }
    arduboy.display();
  }
  arduboy.clear();
  DrawMap();
  arduboy.display();
}
